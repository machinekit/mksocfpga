/dts-v1/ /plugin/;

/ {
  fragment@0 {
    target = <&base_fpga_region>;
    #address-cells = <1>;
    #size-cells = <1>;
    __overlay__ {
      #address-cells = <1>;
      #size-cells = <1>;

	  firmware-name = "zynq/microzed_jd2cb.bit.bin";

	  hm2reg_io_0: hm2-socfpga@0x43C00000 {
		compatible = "machkt,hm2reg-io-1.0";
		reg = < 0x43C00000 0x00010000 >;
	  };
	  axi_uart16550_0: serial@43c10000 {
		clock-frequency = <100000000>;
		clock-names = "ref_clk";
		clocks = <&clkc 0>;
		compatible = "xlnx,xps-uart16550-2.00.a", "ns16550a";
		current-speed = <115200>;
		device_type = "serial";
		interrupt-parent = <&intc>;
		interrupts = <0 30 4>;
		port-number = <0>;
		reg = <0x43c10000 0x10000>;
		reg-offset = <0x1000>;
		reg-shift = <2>;
		xlnx,external-xin-clk-hz = <0x17d7840>;
		xlnx,external-xin-clk-hz-d = <0x19>;
		xlnx,has-external-rclk = <0x0>;
		xlnx,has-external-xin = <0x0>;
		xlnx,is-a-16550 = <0x1>;
		xlnx,s-axi-aclk-freq-hz-d = "100.0";
		xlnx,use-modem-ports = <0x1>;
		xlnx,use-user-ports = <0x1>;
	  };
      axi_uart16550_1: serial@43c20000 {
	    clock-frequency = <100000000>;
	    clock-names = "ref_clk";
	    clocks = <&clkc 0>;
	    compatible = "xlnx,xps-uart16550-2.00.a", "ns16550a";
	    current-speed = <115200>;
	    device_type = "serial";
	    interrupt-parent = <&intc>;
	    interrupts = <0 31 4>;
	    port-number = <1>;
	    reg = <0x43c20000 0x10000>;
	    reg-offset = <0x1000>;
	    reg-shift = <2>;
	    xlnx,external-xin-clk-hz = <0x17d7840>;
	    xlnx,external-xin-clk-hz-d = <0x19>;
	    xlnx,has-external-rclk = <0x0>;
	    xlnx,has-external-xin = <0x0>;
	    xlnx,is-a-16550 = <0x1>;
	    xlnx,s-axi-aclk-freq-hz-d = "100.0";
	    xlnx,use-modem-ports = <0x1>;
	    xlnx,use-user-ports = <0x1>;
      };      
    };
  };
};

