/dts-v1/; /plugin/;

/ {
        fragment@0 {
                target-path = "/soc/base-fpga-region";
                #address-cells = <1>;
                #size-cells = <1>;
                __overlay__ {

                        firmware-name = "%FIRMWARE%";

                        #address-cells = <1>;
                        #size-cells = <1>;

                        ranges = <0x00040000 0xff240000 0x00010000>;
                        fpga-bridges = <&fpga_bridge0>, <&fpga_bridge1>;

                        hm2reg_io_0: hm2-socfpg0@0x40000 {
                                compatible = "hm2reg_io,generic-uio,ui_pdrv";
                                reg = <0x40000 0x10000>;
                                interrupt-parent = <0x2>;
                                interrupts = <0 43 1>;
                                clocks = <&osc1>;
                                address_width = <14>;
                                data_width = <32>;
                        };
                };
        };
};

